## lib/math/Kconfig
```kconfig
# SPDX-License-Identifier: GPL-2.0-only
choice
	prompt "spasm-kernel gcd implementation"
	default SPASM_KERNEL_GCD_SPASM if SPASM_KERNEL_MODE_SPASM
	default SPASM_KERNEL_GCD_DUAL if SPASM_KERNEL_MODE_DUAL
	default SPASM_KERNEL_GCD_C
	depends on X86_64

config SPASM_KERNEL_GCD_C
	bool "Original Linux C implementation"

config SPASM_KERNEL_GCD_SPASM
	bool "SpASM implementation"

config SPASM_KERNEL_GCD_DUAL
	bool "Dual C/SpASM comparison"

endchoice

choice
	prompt "spasm-kernel int_sqrt implementation"
	default SPASM_KERNEL_INT_SQRT_SPASM if SPASM_KERNEL_MODE_SPASM
	default SPASM_KERNEL_INT_SQRT_DUAL if SPASM_KERNEL_MODE_DUAL
	default SPASM_KERNEL_INT_SQRT_C
	depends on X86_64

config SPASM_KERNEL_INT_SQRT_C
	bool "Original Linux C implementation"

config SPASM_KERNEL_INT_SQRT_SPASM
	bool "SpASM implementation"

config SPASM_KERNEL_INT_SQRT_DUAL
	bool "Dual C/SpASM comparison"

endchoice

choice
	prompt "spasm-kernel int_pow implementation"
	default SPASM_KERNEL_INT_POW_SPASM if SPASM_KERNEL_MODE_SPASM
	default SPASM_KERNEL_INT_POW_DUAL if SPASM_KERNEL_MODE_DUAL
	default SPASM_KERNEL_INT_POW_C
	depends on X86_64

config SPASM_KERNEL_INT_POW_C
	bool "Original Linux C implementation"

config SPASM_KERNEL_INT_POW_SPASM
	bool "SpASM implementation"

config SPASM_KERNEL_INT_POW_DUAL
	bool "Dual C/SpASM comparison"

endchoice

choice
	prompt "spasm-kernel lcm implementation"
	default SPASM_KERNEL_LCM_SPASM if SPASM_KERNEL_MODE_SPASM
	default SPASM_KERNEL_LCM_DUAL if SPASM_KERNEL_MODE_DUAL
	default SPASM_KERNEL_LCM_C
	depends on X86_64

config SPASM_KERNEL_LCM_C
	bool "Original Linux C implementation"

config SPASM_KERNEL_LCM_SPASM
	bool "SpASM implementation"

config SPASM_KERNEL_LCM_DUAL
	bool "Dual C/SpASM comparison"

endchoice

config CORDIC
	tristate "CORDIC algorithm"
	help
	  This option provides an implementation of the CORDIC algorithm;
	  calculations are in fixed point. Module will be called cordic.

config PRIME_NUMBERS
	tristate "Simple prime number generator for testing"
	help
	  This option provides a simple prime number generator for test
	  modules.

	  If unsure, say N.

config RATIONAL
	tristate

choice
	prompt "spasm-kernel intlog2 implementation"
	default SPASM_KERNEL_INTLOG2_SPASM if SPASM_KERNEL_MODE_SPASM
	default SPASM_KERNEL_INTLOG2_DUAL if SPASM_KERNEL_MODE_DUAL
	default SPASM_KERNEL_INTLOG2_C
	depends on X86_64

config SPASM_KERNEL_INTLOG2_C
	bool "Original Linux C implementation"

config SPASM_KERNEL_INTLOG2_SPASM
	bool "SpASM implementation"

config SPASM_KERNEL_INTLOG2_DUAL
	bool "Dual C/SpASM comparison"

endchoice

choice
	prompt "spasm-kernel intlog10 implementation"
	default SPASM_KERNEL_INTLOG10_SPASM if SPASM_KERNEL_MODE_SPASM
	default SPASM_KERNEL_INTLOG10_DUAL if SPASM_KERNEL_MODE_DUAL
	default SPASM_KERNEL_INTLOG10_C
	depends on X86_64

config SPASM_KERNEL_INTLOG10_C
	bool "Original Linux C implementation"

config SPASM_KERNEL_INTLOG10_SPASM
	bool "SpASM implementation"

config SPASM_KERNEL_INTLOG10_DUAL
	bool "Dual C/SpASM comparison"

endchoice
```
